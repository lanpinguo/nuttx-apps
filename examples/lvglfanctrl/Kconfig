## examples/lvglfanctrl/Kconfig
```kconfig
#
# For a description of the syntax of this configuration file,
# see the file kconfig-language.txt in the NuttX tools repository.
#

menuconfig EXAMPLES_LVGLFANCTRL
	tristate "LVGL Fan ctrl demo"
	default n
	depends on GRAPHICS_LVGL
	---help---
		Enable build the Light and Versatile Graphics Library Fan ctrl Demo programs

if EXAMPLES_LVGLFANCTRL

config EXAMPLES_LVGLFANCTRL_PRIORITY
	int "lvglfanctrl task priority"
	default 100

config EXAMPLES_LVGLFANCTRL_STACKSIZE
	int "lvglfanctrl stack size"
	default 16384

endif # EXAMPLES_LVGLFANCTRL
```

## examples/spi_test/Kconfig
```kconfig
#
# For a description of the syntax of this configuration file,
# see the file kconfig-language.txt in the NuttX tools repository.
#

config EXAMPLES_SPI_TEST
	tristate "\"SPI TEST!\" example"
	default n
	---help---
		Enable the \"SPI TEST!\" example

if EXAMPLES_SPI_TEST

config EXAMPLES_SPI_TEST_PROGNAME
	string "Program name"
	default "spitest"
	---help---
		This is the name of the program that will be used when the NSH ELF
		program is installed.

config EXAMPLES_SPI_TEST_PRIORITY
	int "SPI_TEST task priority"
	default 100

config EXAMPLES_SPI_TEST_STACKSIZE
	int "SPI_TEST stack size"
	default DEFAULT_TASK_STACKSIZE

endif
```

## wireless/ir/rcsim/Kconfig
```kconfig
#
# For a description of the syntax of this configuration file,
# see the file kconfig-language.txt in the NuttX tools repository.
#

config IR_RCSIM
	tristate "infrared remote-control simulator"
	default n


if IR_RCSIM

config IR_RCSIM_DAEMON_PRIORITY
	int "rcsim task priority"
	default 100

config IR_RCSIM_DAEMON_STACKSIZE
	int "rcsim stack size"
	default DEFAULT_TASK_STACKSIZE

config IR_RCSIM_DEVPATH
	string "ir char driver path"
	default "/dev/lirc0"
	---help---
		The default path to MAC character driver. Default: /dev/ieee0



endif
```
